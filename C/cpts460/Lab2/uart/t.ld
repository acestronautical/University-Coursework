/****************
qemu with -kernel file.bin ==> start to execute from 0x10000 ==>
file.bin must be loaded to 0x10000 ==> . = 0x10000
************/

ENTRY(start)
SECTIONS
{
   . = 0x10000;
   .start . : { ts.o(.text) }
   .text : { *(.text) }
   .data : { *(.data) }
   .bss :  { *(.bss ) }

   . = ALIGN(8);
   . = . + 0x10000; /* 0x1000 for 4KB; x10000=64kB of stack memory */
   stack_top = .;
}

/** QUESTION: show the memory map of the image file generated by the linker **/

/**
----------------------------------------
| text | data | bss | heap -> <- stack |
----------------------------------------
^                                      ^
.start                                  stack_top
0x10000

Output from readelf:
Section Headers:
  [Nr] Name              Type            Addr     Off    Size   ES Flg Lk Inf Al
  [ 0]                   NULL            00000000 000000 000000 00      0   0  0
  [ 1] .start            PROGBITS        00010000 010000 000010 00  AX  0   0  4
  [ 2] .text             PROGBITS        00010010 010010 000f68 00  AX  0   0  4
  [ 3] .rodata           PROGBITS        00010f78 010f78 0000c2 00   A  0   0  4
  [ 4] .data             PROGBITS        0001103c 01103c 00002c 00  WA  0   0  4
  [ 5] .bss              NOBITS          00011068 011068 000024 00  WA  0   0  4
  [ 6] .ARM.attributes   ARM_ATTRIBUTES  00000000 011068 00002e 00      0   0  1
  [ 7] .comment          PROGBITS        00000000 011096 000057 01  MS  0   0  1
  [ 8] .debug_line       PROGBITS        00000000 0110ed 000248 00      0   0  1
  [ 9] .debug_info       PROGBITS        00000000 011335 0007d1 00      0   0  1
  [10] .debug_abbrev     PROGBITS        00000000 011b06 0001a7 00      0   0  1
  [11] .debug_aranges    PROGBITS        00000000 011cb0 000040 00      0   0  8
  [12] .debug_str        PROGBITS        00000000 011cf0 0001a5 01  MS  0   0  1
  [13] .debug_frame      PROGBITS        00000000 011e98 0003a8 00      0   0  4
  [14] .symtab           SYMTAB          00000000 012240 000420 10     15  32  4
  [15] .strtab           STRTAB          00000000 012660 0000ed 00      0   0  1
  [16] .shstrtab         STRTAB          00000000 01274d 0000a1 00      0   0  1
**/
